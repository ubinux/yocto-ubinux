## meta-ubinux/conf/bblayers.conf.sample
```bitbake
# LAYER_CONF_VERSION is increased each time build/conf/bblayers.conf
# changes incompatibly
LCONF_VERSION = "6"

BBPATH = "${TOPDIR}"
BBFILES ?= ""

BBLAYERS ?= " \
  ##COREBASE##/meta-ubinux \
  ##COREBASE##/meta \
  ##COREBASE##/meta-poky \
  ##COREBASE##/meta-yocto-bsp \
  ##COREBASE##/meta-gplv2 \
  ##COREBASE##/meta-freescale \
  ##COREBASE##/meta-oe-zeus/meta-filesystems \
  ##COREBASE##/meta-oe-zeus/meta-gnome \
  ##COREBASE##/meta-oe-zeus/meta-initramfs \
  ##COREBASE##/meta-oe-zeus/meta-networking \
  ##COREBASE##/meta-oe-zeus/meta-oe \
  ##COREBASE##/meta-oe-zeus/meta-python \
  ##COREBASE##/meta-oe-zeus/meta-webserver \
  ##COREBASE##/meta-oe-zeus/meta-xfce \
  ##COREBASE##/meta-oe-zeus/meta-perl \
  ##COREBASE##/meta-oe-zeus/meta-multimedia \
  ##COREBASE##/meta-cgl/meta-cgl-common \
  ##COREBASE##/meta-cloud-services \
  ##COREBASE##/meta-cloud-services/meta-openstack \
  ##COREBASE##/meta-virtualization \
  ##COREBASE##/meta-selinux \
  ##COREBASE##/meta-measured \
  ##COREBASE##/meta-security \
  ##COREBASE##/meta-security/meta-security-compliance \
  ##COREBASE##/meta-qt5 \
  ##COREBASE##/meta-swupdate \
  ##COREBASE##/meta-linaro/meta-linaro  \
  ##COREBASE##/meta-spdxscanner \
  "
BBLAYERS_NON_REMOVABLE ?= " \
  ##COREBASE##/meta-ubinux \
  ##COREBASE##/meta \
  ##COREBASE##/meta-yocto \
  "
LAYERSERIES_COMPAT_ubinux = "zeus"
LAYERSERIES_COMPAT_core = "zeus"
LAYERSERIES_COMPAT_measured = "zeus"
LAYERSERIES_COMPAT_selinux = "zeus"
LAYERSERIES_COMPAT_gplv2 = "zeus"
LAYERSERIES_COMPAT_cloud-services = "zeus"
LAYERSERIES_COMPAT_spdxscanner = "zeus"
LAYERSERIES_COMPAT_openstack = "master"
LAYERSERIES_COMPAT_cgl-common = "zeus"
```

## meta-ubinux/conf/distro/ubinux.conf
```bitbake
require conf/distro/poky.conf

DISTRO = "ubinux" 
DISTRO_NAME = "ubinux"
DISTRO_VERSION = "2025.10"
DISTRO_CODENAME = "Purugly"
SDK_VENDOR = "-ubinuxsdk"
SDK_VERSION := "${@'${DISTRO_VERSION}'}" 

MAINTAINER = "Takuma Ueba <ueba.takuma@fujitsu.com>"

TARGET_VENDOR = "-ubinux"

QEMU_TARGETS = "arm armeb aarch64 aarch64_be i386 mips mipsel mips64 mips64el ppc x86_64"
```

## meta-ubinux/conf/layer.conf
```bitbake
# We have a conf and classes directory, add to BBPATH
#BBPATH := "${BBPATH}:${LAYERDIR}"
#
# We have a packages directory, add to BBFILES
#BBFILES := "${BBFILES} ${LAYERDIR}/recipes-*/*/*.bb"
#
#BBFILE_COLLECTIONS += "skeleton"
#BBFILE_PATTERN_skeleton := "^${LAYERDIR}/"
#BBFILE_PRIORITY_skeleton = "1"


# We have a conf and classes directory, add to BBPATH
BBPATH := "${LAYERDIR}:${BBPATH}"

# # We have a packages directory, add to BBFILES
BBFILES := "${BBFILES} ${LAYERDIR}/recipes-*/*/*.bb \
            ${LAYERDIR}/recipes-*/*/*.bbappend"

BBFILE_COLLECTIONS += "ubinux"
BBFILE_PATTERN_ubinux := "^${LAYERDIR}/"
BBFILE_PRIORITY_ubinux = "10"

LAYERSERIES_COMPAT_ubinux = "kirkstone"

LICENSE_PATH += "${LAYERDIR}/custom-licenses"
```

## meta-ubinux/conf/machine/ubinux-armv7.conf
```bitbake
#@TYPE: Machine
#@NAME: ubinux-armv7
#@DESCRIPTION: Machine configuration for the armv7 of ubinux.

IMAGE_INSTALL:append = " nodejs trousers gobject-introspection swupdate valgrind criu open-iscsi-user "

DEFAULTTUNE = "cortexa9thf-neon"
require conf/machine/include/tune-cortexa9.inc
require conf/machine/include/soc-family.inc

#UBOOT_CONFIG ??= "emmc sdcard qspi-secure-boot qspi"
#UBOOT_CONFIG[emmc] = "ls1046ardb_emmc_defconfig,,u-boot-with-spl-pbl.bin"
#UBOOT_CONFIG[sdcard] = "ls1046ardb_sdcard_config,,u-boot-with-spl-pbl.bin"
#UBOOT_CONFIG[qspi] = "ls1046ardb_qspi_config,,u-boot-dtb.bin"
#UBOOT_CONFIG[qspi-secure-boot] = "ls1046ardb_qspi_SECURE_BOOT_config,,u-boot-dtb.bin"

# Linux Configuration
KERNEL_IMAGETYPE ?= "zImage"
SERIAL_CONSOLE = "115200 ttyPS0"
IMAGE_FSTYPES = "tar.gz"
PREFERRED_PROVIDER_virtual/kernel = "linux-yocto"
KERNEL_DEFCONFIG = "arch/arm/configs/omap2plus_defconfig"

MACHINE_ESSENTIAL_EXTRA_RDEPENDS:remove = "device-tree"
```

## meta-ubinux/conf/machine/ubinux-armv7be.conf
```bitbake
#@TYPE: Machine
#@NAME: ubinux-armv7be
#@DESCRIPTION: Machine configuration for the armv8-32be of ubinux.

MACHINEOVERRIDES =. "fsl-lsch2:fsl-lsch2-32b:ls1043a:"

require conf/machine/include/qoriq-arm.inc
require conf/machine/include/arm/arch-arm64.inc

DEFAULTTUNE = "armv7ahfb-neon"

QE_UCODE = "iram_Type_A_LS1021a_r1.0.bin"

UBOOT_CONFIG ??= "emmc sdcard qspi-secure-boot qspi"
UBOOT_CONFIG[emmc] = "ls1046ardb_emmc_defconfig,,u-boot-with-spl-pbl.bin"
UBOOT_CONFIG[sdcard] = "ls1046ardb_sdcard_config,,u-boot-with-spl-pbl.bin"
UBOOT_CONFIG[qspi] = "ls1046ardb_qspi_config,,u-boot-dtb.bin"
UBOOT_CONFIG[qspi-secure-boot] = "ls1046ardb_qspi_SECURE_BOOT_config,,u-boot-dtb.bin"

KERNEL_DEVICETREE ?= "freescale/fsl-ls1043a-rdb-sdk.dtb freescale/fsl-ls1043a-rdb-usdpaa.dtb"
KERNEL_DEFCONFIG ?= "multi_v7_defconfig"

SERIAL_CONSOLES ?= "115200;ttyS0 115200;ttyAMA0"
SERIAL_CONSOLES_CHECK ?= "${SERIAL_CONSOLES}"

USE_VT = "0"

MACHINE_ESSENTIAL_EXTRA_RDEPENDS:remove = "device-tree"
EXTRA_IMAGEDEPENDS:remove = "u-boot fm-ucode rcw ppa qe-ucode"

PREFERRED_PROVIDER_virtual/kernel = "linux-qoriq"

IMAGE_INSTALL:append = " trousers ltrace systemtap swupdate open-iscsi-user "
```

## meta-ubinux/conf/machine/ubinux-armv8.conf
```bitbake
#@TYPE: Machine
#@NAME: ubinux-armv8
#@DESCRIPTION: Machine configuration for the armv8 of ubinux.

require conf/machine/ls1043ardb.conf

MACHINE_ESSENTIAL_EXTRA_RDEPENDS:remove = "device-tree"

EXTRA_IMAGEDEPENDS:remove = "u-boot fm-ucode rcw ppa ppa-optee qe-ucode uefi ls2-phy qoriq-atf fpga-manager-script fpga-manager-util"
PREFERRED_PROVIDER_virtual/kernel = "linux-qoriq"
PREFERRED_PROVIDER_virtual/qemu = "qemu-xilinx"
PREFERRED_PROVIDER_nativesdk-qemu = "nativesdk-qemu-xilinx"

# For multilib
require conf/multilib.conf
MULTILIBS = "multilib:lib32"
DEFAULTTUNE:virtclass-multilib-lib32 = "armv7ahf-neon"

IMAGE_INSTALL:append = " trousers valgrind ltrace kexec-tools systemtap uftrace swupdate lib32-packagegroup-ubinux-all"

IMAGE_FSTYPES = "tar.gz"
IMAGE_INSTALL:append = " lib32-nodejs lib32-trousers lib32-gobject-introspection lib32-swupdate lib32-valgrind lib32-criu lib32-open-iscsi-user" 
UBOOT_CONFIG = "nand sdcard secure-boot nand-dtb-secure-boot nand-spl-secure-boot nand-secure-boot sdcard-dtb-secure-boot sdcard-spl-secure-boot sdcard-secure-boot nor"
UBOOT_CONFIG[nor] = "ls1043ardb_config,,u-boot-dtb.bin"
UBOOT_CONFIG[nand] = "ls1043ardb_nand_config,,u-boot-with-spl-pbl.bin"
UBOOT_CONFIG[sdcard] = "ls1043ardb_sdcard_config,,u-boot-with-spl-pbl.bin"
UBOOT_CONFIG[secure-boot] = "ls1043ardb_SECURE_BOOT_defconfig,,u-boot-dtb.bin"
UBOOT_CONFIG[nand-secure-boot] = "ls1043ardb_nand_SECURE_BOOT_defconfig,,u-boot-with-spl-pbl.bin"
UBOOT_CONFIG[nand-spl-secure-boot] = "ls1043ardb_nand_SECURE_BOOT_defconfig,,spl/u-boot-spl.bin"
UBOOT_CONFIG[nand-dtb-secure-boot] = "ls1043ardb_nand_SECURE_BOOT_defconfig,,u-boot-dtb.bin"
UBOOT_CONFIG[sdcard-secure-boot] = "ls1043ardb_sdcard_SECURE_BOOT_defconfig,,u-boot-with-spl-pbl.bin"
UBOOT_CONFIG[sdcard-spl-secure-boot] = "ls1043ardb_sdcard_SECURE_BOOT_defconfig,,spl/u-boot-spl.bin"
UBOOT_CONFIG[sdcard-dtb-secure-boot] = "ls1043ardb_sdcard_SECURE_BOOT_defconfig,,u-boot-dtb.bin"
```

## meta-ubinux/conf/machine/ubinux-armv8be.conf
```bitbake
#@TYPE: Machine
#@NAME: ubinux-armv8
#@DESCRIPTION: Machine configuration for the armv8 of ubinux.
require conf/machine/include/qemu.inc
require conf/machine/ls1043ardb-be.conf

MACHINE_ESSENTIAL_EXTRA_RDEPENDS:remove = "device-tree"
EXTRA_IMAGEDEPENDS:remove = "u-boot fm-ucode rcw ppa qe-ucode"

PREFERRED_PROVIDER_virtual/kernel = "linux-qoriq"

# For multilib
#require conf/multilib.conf
#MULTILIBS = "multilib:lib32"
#DEFAULTTUNE_virtclass-multilib-lib32 = "armv7ahfb-neon"

IMAGE_INSTALL:append = " trousers uim systemtap swupdate"
```

## meta-ubinux/conf/machine/ubinux-e500v2.conf
```bitbake
#@TYPE: Machine
#@NAME: ubinux-p1020rdb
#@DESCRIPTION: Machine configuration for the p1020rdb of ubinux.

IMAGE_INSTALL:append = " numactl trousers gobject-introspection uim valgrind ltrace"

require conf/machine/p1020rdb.conf

SERIAL_CONSOLE = "115200 ttyS0 --noclear"
SERIAL_CONSOLES = "115200;ttyS1;--noclear 115200;ttyEHV0;--noclear"
SYSVINIT_ENABLED_GETTYS = ""
#KERNEL_DEFCONFIG = "arch/powerpc/configs/ubq_e500v2_defconfig"

PREFERRED_VERSION_qemu = "2.2.0+fsl"

QEMU_EXTRAOPTIONS_ppce500v2    = " -cpu e500v2"
EXTRA_IMAGEDEPENDS:remove = "u-boot"
```

## meta-ubinux/conf/machine/ubinux-x86-64.conf
```bitbake
#@TYPE: Machine
#@NAME: ubinux-qemux86-64
#@DESCRIPTION: Machine configuration for the qemux86-64 of ubinux.

#IMAGE_INSTALL:append = " dmidecode mcelog libvirt sysdig systemd-boot nodejs numactl trousers criu valgrind kpatch mce-test lib32-packagegroup-ubinux-all "
IMAGE_INSTALL:append = " dmidecode mcelog libvirt sysdig systemd-boot nodejs numactl trousers criu valgrind kpatch mce-test "
require conf/machine/qemux86-64.conf
#PACKAGE_ARCH = "x86_64"
SERIAL_CONSOLE = "115200 ttyS0 --noclear"
SERIAL_CONSOLES = "115200;tty1;--noclear 115200;tty2;--noclear 115200;tty3;--noclear 115200;tty4;--noclear"
SYSVINIT_ENABLED_GETTYS = ""
KMACHINE="x86_64"
KERNEL_DEFCONFIG_ubinux-x86-64 = "x86_64_defconfig"
#PREFERRED_VERSION_qemu = "2.1.0"

# For multilib
require conf/multilib.conf
MULTILIBS = "multilib:lib32"
DEFAULTTUNE:virtclass-multilib-lib32 = "i686"
IMAGE_INSTALL:append = " lib32-jssocket lib32-libjs-jquery-cookie lib32-libjs-jquery-custom-scrollbar lib32-libjs-jquery-dropkick lib32-libjs-jquery-globalize lib32-libjs-jquery-icheck lib32-libjs-jquery-mousewheel lib32-libjs-jquery-ui lib32-smarty lib32-apcupsd lib32-packagegroup-ubinux-all-noconflict"
```

## meta-ubinux/conf/machine/ubinux-x86.conf
```bitbake
#@TYPE: Machine
#@NAME: ubinux-qemux86
#@DESCRIPTION: Machine configuration for the qemux86 of ubinux.

IMAGE_INSTALL:append = " dmidecode systemd-boot nodejs numactl trousers valgrind open-iscsi-user mce-test "

#@TYPE: Machine
#@NAME: common_pc
#@DESCRIPTION: Machine configuration for running a common x86

PREFERRED_PROVIDER_virtual/xserver ?= "xserver-xorg"
PREFERRED_PROVIDER_virtual/libgl ?= "mesa"
PREFERRED_PROVIDER_virtual/libgles1 ?= "mesa"
PREFERRED_PROVIDER_virtual/libgles2 ?= "mesa"

require conf/machine/include/qemu.inc
require conf/machine/include/tune-i686.inc
require conf/machine/include/qemuboot-x86.inc

KERNEL_IMAGETYPE = "bzImage"
SERIAL_CONSOLE = "115200 ttyUSB0"
SERIAL_CONSOLES = "115200;tty1;--noclear 115200;tty2;--noclear 115200;tty3;--noclear 115200;tty4;--noclear"


XSERVER = "xserver-xorg \
           ${@bb.utils.contains('DISTRO_FEATURES', 'opengl', 'mesa-driver-swrast xserver-xorg-extension-glx', '', d)} \
           xf86-video-cirrus \
           xf86-video-fbdev \
           xf86-video-vmware \
           xf86-video-modesetting \
           xserver-xorg-module-libint10 \
           "

MACHINE_FEATURES += "x86 pci"

MACHINE_ESSENTIAL_EXTRA_RDEPENDS += "v86d"

KERNEL_MODULE_AUTOLOAD += "uvesafb"
KERNEL_MODULE_PROBECONF += "uvesafb"
module_conf_uvesafb = "options uvesafb mode_option=${UVESA_MODE}"

WKS_FILE ?= "qemux86-directdisk.wks"
do_image_wic[depends] += "syslinux:do_populate_sysroot syslinux-native:do_populate_sysroot mtools-native:do_populate_sysroot dosfstools-native:do_populate_sysroot"

SYSVINIT_ENABLED_GETTYS = ""
PREFERRED_VERSION_qemu = "2.1.0"
```
